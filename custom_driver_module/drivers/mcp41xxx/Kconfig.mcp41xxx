## custom_driver_module/drivers/mcp41xxx/Kconfig.mcp41xxx
```kconfig
# Kconfig for Microchip MCP41XXX series
#
# Copyright (c) 2025 (Seu Nome)
# SPDX-License-Identifier: Apache-2.0

config POT_MCP41XXX
    bool "Microchip MCP41XXX SPI Digital Potentiometer"
    default y
    # Esta linha faz o driver ser habilitado automaticamente
    # se o devicetree (overlay) encontrar o 'compatible = "microchip,mcp41xxx"'
    depends on DT_HAS_MICROCHIP_MCP41XXX_ENABLED
    # O driver precisa da API de SPI para funcionar
    select SPI
    help
      Enable the custom driver for the MCP41XXX series (MCP41010, MCP41050, MCP41100).
```

## custom_driver_module/dts/bindings/microchip,mcp41xxx.yaml
```yaml
# Copyright (c) 2025 (Seu Nome)
# SPDX-License-Identifier: Apache-2.0
description: |
  Microchip MCP41XXX (MCP41010, MCP41050, MCP41100)
  Single-Tap SPI Digital Potentiometer.

# O 'compatible' que você usará no seu overlay
compatible: "microchip,mcp41xxx"

# É um dispositivo SPI, então incluímos as definições padrão de SPI
include: spi-device.yaml

on-bus: spi


properties:
  resistance:
    type: int
    required: true
    description: |
      A resistência total (R-ab) do potenciômetro digital em kOhms (kilo-ohms).
      O driver usa isso para calcular o valor do "tap".
    enum:
      - 10   # (Para o MCP41010 - 10 kOhm)
      - 50   # (Para o MCP41050 - 50 kOhm)
      - 100  # (Para o MCP41100 - 100 kOhm)
```
